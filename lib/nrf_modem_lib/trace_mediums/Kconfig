## lib/nrf_modem_lib/trace_mediums/Kconfig
```kconfig
# Copyright (c) 2022 Nordic Semiconductor
#
# SPDX-License-Identifier: LicenseRef-Nordic-5-Clause
#
choice NRF_MODEM_LIB_TRACE_MEDIUM
	prompt "Trace medium"
	default NRF_MODEM_LIB_TRACE_MEDIUM_UART

config NRF_MODEM_LIB_TRACE_MEDIUM_UART
	bool "UARTE1"
	# Modem tracing over UART use the UARTE1 as a dedicated peripheral.
	# This enables the UARTE1 peripheral and includes nrfx UARTE driver.
	select NRFX_UARTE1
	# TF-M use UARTE1 as log output, to avoid a conflict disable logging
	# in TF-M.
	select TFM_LOG_LEVEL_SILENCE if BUILD_WITH_TFM

config NRF_MODEM_LIB_TRACE_MEDIUM_RTT
	bool "SEGGER RTT"
	select USE_SEGGER_RTT

endchoice # NRF_MODEM_LIB_TRACE_MEDIUM

if NRF_MODEM_LIB_TRACE_MEDIUM_RTT

config NRF_MODEM_LIB_TRACE_MEDIUM_RTT_BUF_SIZE
	int "RTT buffer size"
	default 255

endif # NRF_MODEM_LIB_TRACE_MEDIUM_RTT

module = MODEM_TRACE_MEDIUM
module-str = Modem trace medium
source "subsys/logging/Kconfig.template.log_config"
```

## samples/nrf9160/custom_trace_medium/custom_medium/Kconfig
```kconfig
#
# Copyright (c) 2022 Nordic Semiconductor
#
# SPDX-License-Identifier: LicenseRef-Nordic-5-Clause
#

if NRF_MODEM_LIB_TRACE_ENABLED

# Updates the trace medium choice with another medium.
choice NRF_MODEM_LIB_TRACE_MEDIUM

config NRF_MODEM_LIB_TRACE_MEDIUM_CUSTOM
	bool "Count modem traces and print to terminal"
	help
	  Print modem trace data statistics
	  and cpu utilization.

endchoice # NRF_MODEM_LIB_TRACE_MEDIUM

endif # NRF_MODEM_LIB_TRACE_ENABLED
```

## tests/lib/modem_trace/modem_trace/testcase.yaml
```yaml
tests:
  lib.modem_trace:
    platform_allow: qemu_cortex_m3
    integration_platforms:
      - qemu_cortex_m3
    tags: modem_trace
```

## tests/lib/modem_trace/trace_medium_uart/testcase.yaml
```yaml
tests:
  lib.trace_medium_uart:
    platform_allow: qemu_cortex_m3
    integration_platforms:
      - qemu_cortex_m3
    tags: modem_trace
```
